## boards/shields/handwired/Kconfig.defconfig
```kconfig
if SHIELD_HANDWIRED

config ZMK_KEYBOARD_NAME
    default "gamer device 7"

endif
```

## boards/shields/rollow/Kconfig.defconfig
```kconfig
if SHIELD_ROLLOW_LEFT

config ZMK_KEYBOARD_NAME
    default "gamer device 3"

config ZMK_SPLIT_ROLE_CENTRAL
    default y

endif

if SHIELD_ROLLOW_LEFT || SHIELD_ROLLOW_RIGHT

config ZMK_SPLIT
    default y

endif
```

## boards/shields/rollow/Kconfig.shield
```kconfig
config SHIELD_ROLLOW_LEFT
    def_bool $(shields_list_contains,rollow_left)

config SHIELD_ROLLOW_RIGHT
    def_bool $(shields_list_contains,rollow_right)
```

## config/west.yml
```yaml
manifest:
  remotes:
    - name: zmkfirmware
      url-base: https://github.com/zmkfirmware
    - name: caksoylar
      url-base: https://github.com/caksoylar
    - name: ameeryaqoob
      url-base: https://github.com/ameeryaqoob
    # Additional modules containing boards/shields/custom code can be listed here as well
    # See https://docs.zephyrproject.org/3.2.0/develop/west/manifest.html#projects
  projects:
    - name: zmk
      remote: caksoylar
      revision: feat/mouse-keys-3.2
      import: app/west.yml
    - name: zmk-config
      remote: ameeryaqoob
      revision: main
      import: boards/shields
  self:
    path: config
```
