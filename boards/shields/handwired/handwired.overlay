/ {
    chosen {
        zmk,kscan = &kscan0;
    };

    kscan0: kscan_0 {
        compatible = "zmk,kscan-gpio-matrix";
        diode-direction = "col2row";

        col-gpios
            = <&pro_micro 5 GPIO_ACTIVE_HIGH> //1
            , <&pro_micro 6 GPIO_ACTIVE_HIGH> //2
            , <&pro_micro 7 GPIO_ACTIVE_HIGH> //3
            , <&pro_micro 8 GPIO_ACTIVE_HIGH> //4
            , <&pro_micro 9 GPIO_ACTIVE_HIGH> //5
            , <&pro_micro 21 GPIO_ACTIVE_HIGH> //6
            , <&pro_micro 20 GPIO_ACTIVE_HIGH> //7
            , <&pro_micro 19 GPIO_ACTIVE_HIGH> //8
            , <&pro_micro 18 GPIO_ACTIVE_HIGH> //9
            , <&pro_micro 15 GPIO_ACTIVE_HIGH> //10
            , <&pro_micro 14 GPIO_ACTIVE_HIGH> //11
            , <&pro_micro 16 GPIO_ACTIVE_HIGH> //12
            , <&pro_micro 10 GPIO_ACTIVE_HIGH> //13
            , <&gpio0 17 GPIO_ACTIVE_HIGH>; //14

        row-gpios
            = <&pro_micro 0 (GPIO_ACTIVE_HIGH | GPIO_PULL_DOWN)>
            , <&pro_micro 1 (GPIO_ACTIVE_HIGH | GPIO_PULL_DOWN)>
            , <&pro_micro 2 (GPIO_ACTIVE_HIGH | GPIO_PULL_DOWN)>
            , <&pro_micro 3 (GPIO_ACTIVE_HIGH | GPIO_PULL_DOWN)>
            , <&pro_micro 4 (GPIO_ACTIVE_HIGH | GPIO_PULL_DOWN)>;
    };
};